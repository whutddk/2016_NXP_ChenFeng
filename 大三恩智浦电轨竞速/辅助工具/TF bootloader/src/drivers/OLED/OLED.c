#include "common.h"
#include "OLED.h"
#include "gpio.h"
#include "delay.h"


#define XLevelL		0x00
#define XLevelH		0x10
#define XLevel		((XLevelH&0x0F)*16+XLevelL)
#define Max_Column	128
#define Max_Row		  64
#define	Brightness	0xCF

/*
4线SPI使用说明：
VBT 供内部DC-DC电压，3.3~4.3V，如果使用5V电压，为保险起见串一个100~500欧的电阻
VCC 供内部逻辑电压 1.8~6V
GND 地

BS0 低电平
BS1 低电平
BS2 低电平

CS  片选管脚
DC  命令数据选择管脚
RES 模块复位管脚
D0（SCLK） ，时钟脚，由MCU控制
D1（MOSI） ，主输出从输入数据脚，由MCU控制

D2 悬空
D3-D7 ， 低电平 ， 也可悬空，但最好设为低电平
RD  低电平 ，也可悬空，但最好设为低电平
RW  低电平 ，也可悬空，但最好设为低电平
RD  低电平 ，也可悬空，但最好设为低电平
C7---D0（SCLK）时钟脚，由MCU控制
C6---D1（MOSI）主输出从输入数据脚，由MCU控制
C0---RST 模块复位管脚
C4---DC  命令数据选择管脚*/

#define X_WIDTH 128
#define Y_WIDTH 64


unsigned char OLED_buffer[1024];

//======================================
const byte F6x8[][6] =
{
    { 0x00, 0x00, 0x00, 0x00, 0x00, 0x00 },   // sp
    { 0x00, 0x00, 0x00, 0x2f, 0x00, 0x00 },   // !
    { 0x00, 0x00, 0x07, 0x00, 0x07, 0x00 },   // "
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    { 0x14, 0x14, 0x14, 0x14, 0x14, 0x14 }    // horiz lines
};
const byte F14x16_Idx[] =
{
    "广州科技飞思卡尔智能车专营店首选液晶"
};
const byte F14x16[] = {
/*--  文字:  广  --*/
/*--  宋体12;  此字体下对应的点阵为：宽x高=16x16   --*/
0x00,0xFC,0x04,0x04,0x04,0x04,0x05,0x06,0x04,0x04,0x04,0x04,0x04,0x04,
0x30,0x0F,0x00,0x00,0x00,0x00,0x00,0x00,0x00,0x00,0x00,0x00,0x00,0x00,

/*--  文字:  州  --*/
/*--  宋体12;  此字体下对应的点阵为：宽x高=16x16   --*/
0xE0,0x00,0x00,0xFF,0x20,0xC0,0x00,0xFE,0x10,0x60,0x80,0x00,0xFF,0x00,
0x80,0x60,0x18,0x07,0x00,0x00,0x00,0x7F,0x00,0x00,0x01,0x00,0xFF,0x00,
/*--  文字:  科  --*/
/*--  宋体12;  此字体下对应的点阵为：宽x高=16x16   --*/
0x12,0x92,0x72,0xFE,0x51,0x91,0x00,0x22,0xCC,0x00,0x00,0xFF,0x00,0x00,
0x02,0x01,0x00,0xFF,0x00,0x04,0x04,0x04,0x02,0x02,0x02,0xFF,0x01,0x01,

/*--  文字:  技  --*/
/*--  宋体12;  此字体下对应的点阵为：宽x高=16x16   --*/
0x08,0x88,0xFF,0x48,0x28,0x00,0xC8,0x48,0x48,0x7F,0x48,0xC8,0x48,0x08,
0x41,0x80,0x7F,0x00,0x40,0x40,0x20,0x13,0x0C,0x0C,0x12,0x21,0x60,0x20,

/*--  文字:  飞  --*/
/*--  宋体12;  此字体下对应的点阵为：宽x高=16x16   --*/
0x02,0x02,0x02,0x02,0x02,0x02,0x02,0x02,0xFE,0x60,0x90,0x08,0x00,0x00,
0x00,0x00,0x00,0x00,0x00,0x00,0x00,0x00,0x03,0x0C,0x10,0x21,0x40,0x78,

/*--  文字:  思  --*/
/*--  宋体12;  此字体下对应的点阵为：宽x高=16x16   --*/
0x00,0x00,0xFE,0x92,0x92,0x92,0xFE,0x92,0x92,0x92,0x92,0xFE,0x00,0x00,
0x38,0x00,0x00,0x3C,0x40,0x40,0x42,0x4C,0x40,0x40,0x70,0x04,0x18,0x30,

/*--  文字:  卡  --*/
/*--  宋体12;  此字体下对应的点阵为：宽x高=16x16   --*/
0x40,0x40,0x40,0x40,0x40,0x40,0xFF,0x44,0x44,0x44,0x44,0x44,0x44,0x40,
0x00,0x00,0x00,0x00,0x00,0x00,0xFF,0x00,0x02,0x04,0x0C,0x38,0x10,0x00,

/*--  文字:  尔  --*/
/*--  宋体12;  此字体下对应的点阵为：宽x高=16x16   --*/
0x40,0x20,0x10,0x0C,0xCB,0x8A,0x18,0xE8,0x08,0x88,0x08,0x28,0x18,0x08,
0x10,0x08,0x04,0x02,0x01,0x40,0x80,0x7F,0x00,0x00,0x01,0x0E,0x04,0x00,

/*--  文字:  智  --*/
/*--  宋体12;  此字体下对应的点阵为：宽x高=16x16   --*/
0x14,0x13,0x92,0x7E,0x32,0x52,0x92,0x00,0x7C,0x44,0x44,0x44,0x7C,0x00,
0x01,0x01,0x00,0xFF,0x49,0x49,0x49,0x49,0x49,0x49,0xFF,0x00,0x00,0x00,

/*--  文字:  能  --*/
/*--  宋体12;  此字体下对应的点阵为：宽x高=16x16   --*/
0xB8,0x97,0x92,0x90,0x94,0xB8,0x10,0x00,0x7F,0x48,0x48,0x44,0x74,0x20,
0xFF,0x0A,0x0A,0x4A,0x8A,0x7F,0x00,0x00,0x3F,0x44,0x44,0x42,0x72,0x20,

/*--  文字:  车  --*/
/*--  宋体12;  此字体下对应的点阵为：宽x高=16x16   --*/
0x04,0x84,0xC4,0xA4,0x9C,0x87,0x84,0xF4,0x84,0x84,0x84,0x84,0x84,0x00,
0x04,0x04,0x04,0x04,0x04,0x04,0x04,0xFF,0x04,0x04,0x04,0x04,0x04,0x04,

/*--  文字:  专  --*/
/*--  宋体12;  此字体下对应的点阵为：宽x高=16x16   --*/
0x20,0x24,0x24,0xA4,0x64,0x3C,0x27,0x24,0x24,0xA4,0x24,0x24,0x20,0x20,
0x00,0x00,0x00,0x01,0x01,0x09,0x11,0x29,0x45,0x03,0x01,0x00,0x00,0x00,

/*--  文字:  营  --*/
/*--  宋体12;  此字体下对应的点阵为：宽x高=16x16   --*/
0x34,0x14,0x14,0xD4,0x5F,0x54,0x54,0x54,0x5F,0xD4,0x14,0x54,0x34,0x14,
0x00,0x00,0xF8,0x4B,0x4A,0x4A,0x4A,0x4A,0x4A,0x4B,0xF8,0x00,0x00,0x00,

/*--  文字:  店  --*/
/*--  宋体12;  此字体下对应的点阵为：宽x高=16x16   --*/
0x00,0xFC,0x04,0x04,0x04,0x04,0x05,0xFE,0x44,0x44,0x44,0x44,0x44,0x04,
0x30,0x0F,0x00,0x00,0x7E,0x22,0x22,0x23,0x22,0x22,0x22,0x7E,0x00,0x00,

/*--  文字:  首  --*/
/*--  宋体12;  此字体下对应的点阵为：宽x高=16x16   --*/
0x04,0x04,0xE4,0x25,0x26,0x34,0x2C,0x24,0x24,0x26,0xE5,0x04,0x04,0x04,
0x00,0x00,0x7F,0x25,0x25,0x25,0x25,0x25,0x25,0x25,0x7F,0x00,0x00,0x00,

/*--  文字:  选  --*/
/*--  宋体12;  此字体下对应的点阵为：宽x高=16x16   --*/
0x40,0x42,0xCC,0x00,0x50,0x4E,0xC8,0x48,0x7F,0xC8,0x48,0x48,0x40,0x00,
0x40,0x20,0x1F,0x20,0x48,0x46,0x41,0x40,0x40,0x47,0x48,0x48,0x4E,0x40,

/*--  文字:  液  --*/
/*--  宋体12;  此字体下对应的点阵为：宽x高=16x16   --*/
0x61,0x06,0xE0,0x18,0x84,0xE4,0x1C,0x84,0x65,0xBE,0x24,0xA4,0x64,0x04,
0x04,0xFF,0x00,0x01,0x00,0xFF,0x41,0x21,0x12,0x0C,0x1B,0x61,0xC0,0x40,

/*--  文字:  晶  --*/
/*--  宋体12;  此字体下对应的点阵为：宽x高=16x16   --*/
0x00,0x00,0x00,0x7E,0x2A,0x2A,0x2A,0x2A,0x2A,0x2A,0x7E,0x00,0x00,0x00,
0x7F,0x25,0x25,0x25,0x25,0x7F,0x00,0x00,0x7F,0x25,0x25,0x25,0x25,0x7F,
};

//======================================================
// 128X64I液晶底层驱动[8X16]字体库
// 设计者: powerint
// 描  述: [8X16]西文字符的字模数据 (纵向取模,字节倒序)
// !"#$%&'()*+,-./0123456789:;<=>?@ABCDEFGHIJKLMNOPQRSTUVWXYZ[\]^_`abcdefghijklmnopqrstuvwxyz{|}~
//======================================================
const byte F8X16[]=
{
  0x00,0x00,0x00,0x00,0x00,0x00,0x00,0x00,0x00,0x00,0x00,0x00,0x00,0x00,0x00,0x00,// 0
  0x00,0x00,0x00,0xF8,0x00,0x00,0x00,0x00,0x00,0x00,0x00,0x33,0x30,0x00,0x00,0x00,//!1
  0x00,0x10,0x0C,0x06,0x10,0x0C,0x06,0x00,0x00,0x00,0x00,0x00,0x00,0x00,0x00,0x00,//"2
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  0x00,0x06,0x01,0x01,0x02,0x02,0x04,0x04,0x00,0x00,0x00,0x00,0x00,0x00,0x00,0x00,//~94

};

byte logo[456] = {
0x00,0x0E,0xFC,0xF0,0xE0,0xC0,0x80,0x00,0x00,0x00,0x00,0x00,0x00,0x00,0x00,0x00,
0x1C,0xF8,0xF0,0xE0,0x80,0x00,0x00,0x00,0x00,0x00,0x00,0x00,0x00,0x00,0x00,0x00,
0x00,0x00,0x00,0x00,0x80,0xE0,0xF0,0xF8,0x1C,0x00,0x00,0x00,0x00,0x00,0x00,0x00,
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0x00,0x00,0x00,0x00,0x00,0x00,0x00,0x00,/*"C:\Users\MR.Wen\Desktop\rygrt.BMP",0*/
};
/*显示偏差条数组*/
byte weizhi[256]={
0x7C,0x7C,0x00,0x00,0x00,0x00,0x00,0x00,0x00,0x00,0x00,0x00,0x00,0x00,0x00,0x00,
0x00,0x00,0x00,0x00,0x00,0x00,0x00,0x00,0x00,0x00,0x00,0x00,0x00,0x00,0x00,0x00,
0x00,0x00,0x00,0x00,0x00,0x00,0x00,0x00,0x00,0x00,0x00,0x00,0x00,0x00,0x00,0x00,
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0xF0,0x80,0xF0,0x80,0xF0,0x80,0xF0,0x80,0xF0,0x80,0xF0,0x80,0xF0,0x80,0x80,0xFE
};

/*显示电量数组*/
byte dianchi[64] = {
0x00,0x00,0x00,0xF0,0xF0,0x00,0xFC,0x04,0x04,0x04,0x04,0x04,0x04,0x04,0x04,0x04,
0x04,0x04,0x04,0x04,0x04,0x04,0x04,0x04,0x04,0x04,0x04,0x04,0x04,0x04,0xFC,0x00,
0x00,0x00,0x00,0x0F,0x0F,0x00,0x3F,0x20,0x20,0x20,0x20,0x20,0x20,0x20,0x20,0x20,
0x20,0x20,0x20,0x20,0x20,0x20,0x20,0x20,0x20,0x20,0x20,0x20,0x20,0x20,0x3F,0x00
};

/*显示蓝牙信号数组*/
byte xinghao[64] = {
0x08,0x10,0x20,0x40,0xFF,0x82,0x44,0x28,0x10,0x00,0x00,0x00,0x00,0x00,0x00,0x00,
0x00,0x00,0x00,0x00,0x00,0x00,0x00,0x80,0x00,0xC0,0x00,0xE0,0x00,0xF0,0x00,0x00,
0x08,0x04,0x02,0x01,0x7F,0x20,0x11,0x0A,0x04,0x00,0x00,0x20,0x00,0x30,0x00,0x38,
0x00,0x3C,0x00,0x3E,0x00,0x3F,0x00,0x3F,0x00,0x3F,0x00,0x3F,0x00,0x3F,0x00,0x00
};

void  delayms(uint32  ms)
{

    uint32  i, j;
    for(i = 0; i < ms; i++)
    {
        for(j = bus_clk_khz; j > 0; j--)
        {
            asm("nop");
        }
    }
}

void LCD_WrDat(byte data)
{
	byte i=8;
	CS1LOW();;;;
	CS2LOW();;;;
	asm("nop");
    CLKLOW();;;;
	asm("nop");
	MOSIHIGH();;;;
	asm("nop");
	CLKHIGH();;;;;
	asm("nop");
	CLKLOW();;;;;
	while(i--)
	{
	  if(data&0x80)
		  {MOSIHIGH();;;;}
	  else
		  {MOSILOW();;;;}
	  CLKHIGH();;;;;
	  asm("nop");
	  CLKLOW();;;;;
	  data<<=1;
	}
	CS1HIGH();;;;;
	CS2HIGH();;;;;
}

void LCD_WrCmd(byte cmd)
{
	byte i=8;
	CS1LOW();;;;
	CS2LOW();;;;
	asm("nop");	
    CLKLOW();;;;
	asm("nop");
	MOSILOW();;;;
	asm("nop");
	CLKHIGH();;;;;
	asm("nop");
	CLKLOW();;;;;
	while(i--)
	{
	  if(cmd&0x80)
		  {MOSIHIGH();;;;;}
	  else
		  {MOSILOW();;;;;;}
	  CLKHIGH();;;;;
	  asm("nop");
	  CLKLOW();;;;;
	  cmd<<=1;;;;;
	}
	CS1HIGH();;;;;
	CS2HIGH();;;;;
}



void LCD_Set_Pos(byte x, byte y)
{
  LCD_WrCmd(0xb0+y);
  LCD_WrCmd(((x&0xf0)>>4)|0x10);
  LCD_WrCmd(x&0x0f);//|0x01);原来的版本图像整体右移一列，导致低128列移到第一列显示，不知道这么做是为什么，暂时先改回来
}

/**************************实现函数********************************************
*函数原型:		void LCD_SetXY(unsigned char X,unsigned char Y)
*功　　能:		将OLED的光标设置到 X,Y 坐标。
*******************************************************************************/
void LCD_SetXY(unsigned char X,unsigned char Y)
{
	LCD_WrCmd(0x22);
	LCD_WrCmd(Y);
	LCD_WrCmd(7);
	LCD_WrCmd(0x21);
	LCD_WrCmd(X);
	LCD_WrCmd(127);
}

void LCD_Fill(byte bmp_data)
{
	byte y,x;
	
	for(y=0;y<8;y++)
	{
		LCD_WrCmd(0xb0+y);
		LCD_WrCmd(0x01);
		LCD_WrCmd(0x10);
		for(x=0;x<X_WIDTH;x++)
			LCD_WrDat(bmp_data);
	}
}

void LCD_CLS(void)
{
	byte y,x;	
	for(y=0;y<8;y++)
	{
		LCD_WrCmd(0xb0+y);
		LCD_WrCmd(0x01);
		LCD_WrCmd(0x10);
		for(x=0;x<X_WIDTH;x++)
			LCD_WrDat(0);
	}
}
void LCD_DLY_ms(word ms)
{
  word a;
  while(ms)
  {
    a=13350;
    while(a--);
    ms--;
  }
  return;
}
/*
C7---D0（SCLK）时钟脚，由MCU控制A26
C6---D1（MOSI）主输出从输入数据脚，由MCU控制A27
C0---RST 模块复位管脚A24
C4---DC  命令数据选择管脚A25
*/
void OLED_Init(void)
{
  gpio_init  (PORTE,6,GPO,1);//CS1
  gpio_init  (PORTE,5,GPO,1);//CS2
  gpio_init  (PORTE,2,GPO,1);//CLK
  gpio_init  (PORTE,1,GPO,1);//MOSI


//  GPIOA_PDOR=GPIO_PDDR_PDD(GPIO_PIN(26)|GPIO_PIN(27)|GPIO_PIN(24)|GPIO_PIN(25));
//  GPIOA_PDOR |=  GPIO_PDOR_PDO(GPIO_PIN(26));
  //LCD_CS=1;	//预制SLK和SS为高电平   	
//  GPIOA_PDOR &= ~GPIO_PDOR_PDO(GPIO_PIN(24));
 // LCD_DLY_ms(50);
 // GPIOA_PDOR |=  GPIO_PDOR_PDO(GPIO_PIN(24));

  LCD_WrCmd(0xae);//--turn off oled panel
  LCD_WrCmd(0x00);//---set low column address
  LCD_WrCmd(0x10);//---set high column address
  LCD_WrCmd(0x40);//--set start line address  Set Mapping RAM Display Start Line (0x00~0x3F)
  LCD_WrCmd(0x81);//--set contrast control register
  LCD_WrCmd(0xcf); // Set SEG Output Current Brightness
  LCD_WrCmd(0xa1);//--Set SEG/Column Mapping     0xa0左右反置 0xa1正常
  LCD_WrCmd(0xc8);//Set COM/Row Scan Direction   0xc0上下反置 0xc8正常
  LCD_WrCmd(0xa6);//--set normal display
  LCD_WrCmd(0xa8);//--set multiplex ratio(1 to 64)
  LCD_WrCmd(0x3f);//--1/64 duty
  LCD_WrCmd(0xd3);//-set display offset	Shift Mapping RAM Counter (0x00~0x3F)
  LCD_WrCmd(0x00);//-not offset
  LCD_WrCmd(0xd5);//--set display clock divide ratio/oscillator frequency
  LCD_WrCmd(0x80);//--set divide ratio, Set Clock as 100 Frames/Sec
  LCD_WrCmd(0xd9);//--set pre-charge period
  LCD_WrCmd(0xf1);//Set Pre-Charge as 15 Clocks & Discharge as 1 Clock
  LCD_WrCmd(0xda);//--set com pins hardware configuration
  LCD_WrCmd(0x12);
  LCD_WrCmd(0xdb);//--set vcomh
  LCD_WrCmd(0x40);//Set VCOM Deselect Level
  LCD_WrCmd(0x20);//-Set Page Addressing Mode (0x00/0x01/0x02)
  LCD_WrCmd(0x02);//
  LCD_WrCmd(0x8d);//--set Charge Pump enable/disable
  LCD_WrCmd(0x14);//--set(0x10) disable
  LCD_WrCmd(0xa4);// Disable Entire Display On (0xa4/0xa5)
  LCD_WrCmd(0xa6);// Disable Inverse Display On (0xa6/a7)
  LCD_WrCmd(0xaf);//--turn on oled panel
  LCD_Fill(0x00);  //初始清屏
  LCD_Set_Pos(0,0);
	
}
//==============================================================
//函数名： void LCD_PutPixel(byte x,byte y)
//功能描述：绘制一个点（x,y）
//参数：真实坐标值(x,y),x的范围0～127，y的范围0～64
//返回：无
//==============================================================
void LCD_PutPixel(byte x,byte y)
{
	byte data1;  //data1当前点的数据
	
        LCD_Set_Pos(x,y);
	data1 = 0x01<<(y%8); 	
	LCD_WrCmd(0xb0+(y>>3));
	LCD_WrCmd(((x&0xf0)>>4)|0x10);
	LCD_WrCmd((x&0x0f)|0x00);
	LCD_WrDat(data1); 	 	
}



//==============================================================
//函数名： void LCD_Rectangle(byte x1,byte y1,
//                   byte x2,byte y2,byte color,byte gif)
//功能描述：绘制一个实心矩形
//参数：左上角坐标（x1,y1）,右下角坐标（x2，y2）
//      其中x1、x2的范围0～127，y1，y2的范围0～63，即真实坐标值
//返回：无
//==============================================================
void LCD_Rectangle(byte x1,byte y1,byte x2,byte y2,byte gif)
{
	byte n;
		
	LCD_Set_Pos(x1,y1>>3);
	for(n=x1;n<=x2;n++)
	{
		LCD_WrDat(0x01<<(y1%8)); 			
		if(gif == 1) 	LCD_DLY_ms(50);
	}
	LCD_Set_Pos(x1,y2>>3);
    for(n=x1;n<=x2;n++)
	{
		LCD_WrDat(0x01<<(y2%8)); 			
		if(gif == 1) 	LCD_DLY_ms(5);
	}
	
}
//==============================================================
//函数名：LCD_P6x8Str(byte x,byte y,byte *p)
//功能描述：写入一组标准ASCII字符串
//参数：显示的位置（x,y），y为页范围0～7，要显示的字符串
//返回：无
//==============================================================
void LCD_P6x8Str(byte x,byte y,byte ch[])
{
  byte c=0,i=0,j=0;
  while (ch[j]!='\0')
  {
    c =ch[j]-32;
    if(x>126){x=0;y++;}
    LCD_Set_Pos(x,y);
  	for(i=0;i<6;i++)
  	  LCD_WrDat(F6x8[c][i]);
  	x+=6;
  	j++;
  }
}
//==============================================================
//函数名：LCD_P8x16Str(byte x,byte y,byte *p)
//功能描述：写入一组标准ASCII字符串
//参数：显示的位置（x,y），y为页范围0～7，要显示的字符串
//返回：无
//==============================================================
void LCD_P8x16Str(byte x,byte y,byte ch[])
{
  byte c=0,i=0,j=0;

  while (ch[j]!='\0')
  {
    c =ch[j]-32;
    if(x>120){x=0;y++;}
    LCD_Set_Pos(x,y);
  	for(i=0;i<8;i++)
  	  LCD_WrDat(F8X16[c*16+i]);
  	LCD_Set_Pos(x,y+1);
  	for(i=0;i<8;i++)
  	  LCD_WrDat(F8X16[c*16+i+8]);
  	x+=8;
  	j++;
  }
}
//输出汉字字符串
void LCD_P14x16Str(byte x,byte y,byte ch[])
{
	byte wm=0,ii = 0;
	word adder=1;
	
	while(ch[ii] != '\0')
	{
  	wm = 0;
  	adder = 1;
  	while(F14x16_Idx[wm] > 127)
  	{
  		if(F14x16_Idx[wm] == ch[ii])
  		{
  			if(F14x16_Idx[wm + 1] == ch[ii + 1])
  			{
  				adder = wm * 14;
  				break;
  			}
  		}
  		wm += 2;			
  	}
  	if(x>118){x=0;y++;}
  	LCD_Set_Pos(x , y);
  	if(adder != 1)// 显示汉字					
  	{
  		LCD_Set_Pos(x , y);
  		for(wm = 0;wm < 14;wm++)
  		{
  			LCD_WrDat(F14x16[adder]);	
  			adder += 1;
  		}
  		LCD_Set_Pos(x,y + 1);
  		for(wm = 0;wm < 14;wm++)
  		{
  			LCD_WrDat(F14x16[adder]);
  			adder += 1;
  		}   		
  	}
  	else			  //显示空白字符			
  	{
  		ii += 1;
      LCD_Set_Pos(x,y);
  		for(wm = 0;wm < 16;wm++)
  		{
  				LCD_WrDat(0);
  		}
  		LCD_Set_Pos(x,y + 1);
  		for(wm = 0;wm < 16;wm++)
  		{   		
  				LCD_WrDat(0);	
  		}
  	}
  	x += 14;
  	ii += 2;
	}
}
//输出汉字和字符混合字符串
void LCD_Print(byte x, byte y, byte ch[])
{
	byte ch2[3];
	byte ii=0;
	while(ch[ii] != '\0')
	{
		if(ch[ii] > 127)
		{
			ch2[0] = ch[ii];
	 		ch2[1] = ch[ii + 1];
			ch2[2] = '\0';			//汉字为两个字节
			LCD_P14x16Str(x , y, ch2);	//显示汉字
			x += 14;
			ii += 2;
		}
		else
		{
			ch2[0] = ch[ii];	
			ch2[1] = '\0';			//字母占一个字节
			LCD_P8x16Str(x , y , ch2);	//显示字母
			x += 8;
			ii+= 1;
		}
	}
}

//==============================================================
//函数名： void Draw_BMP(byte x,byte y)
//功能描述：显示BMP图片128×64
//参数：起始点坐标(x,y),x的范围0～127，y为页的范围0～7
//返回：无
//==============================================================
void Draw_BMP(byte x0,byte y0,byte x1,byte y1,byte *bmp)
{ 	
//  word ii=0;
  byte x,y;

  if(y1%8==0)
    y=y1/8;
  else
    y=y1/8+1;
  for(y=y0;y<=y1;y++)
  {
    LCD_Set_Pos(x0,y);				
    for(x=x0;x<=x1;x++)
    {
      LCD_WrDat(*bmp++);	    	
    }
  }
}

void Dis_Num(byte y, byte x, u32 num,byte N)
{
//  byte line;
  byte j=0;
  byte n[7]={0};
  x=x*8;
  if(num>=100000)
    n[0]=((num/100000)%10)+16+32;
  else
	n[0]=32;
  n[1]=((num/10000)%10)+16+32;
  n[2]=((num/1000)%10)+16+32;
  n[3]=((num/100)%10)+16+32;
  n[4]=((num/10)%10)+16+32;
  n[5]=(num%10)+16+32;

  //for(j=0;j<6;j++)
	//n[j]=n[j]+16+32;
  LCD_P8x16Str(x,y,&n[6-N]);//从ACSII码表中读取字节，然后写入液晶
}

void Dis_Numbfb(byte y, byte x, u8 num)
{
  byte n[5]={0};
  x=x*8;
  n[0]=((num/100)%10)+16+32;
   if(n[0]==48)
	 n[0]=32;
  n[1]=((num/10)%10)+16+32;
   //if(n[1]==48)
	// n[1]=32;
  n[2]=(num%10)+16+32;
  n[3]=37;
  LCD_P8x16Str(x,y,&n[0]);//从ACSII码表中读取字节，然后写入液晶
}

void Dis_LOGO()
{
	Draw_BMP(36,0,92,7,logo);
	delayms(400);            //显示LOGO延时
	LCD_Fill(0x00);  //初始清屏
}

void Dis_err(byte y, byte x, int16 num)
{
  byte n[6]={0};
  x=x*8;
  if(num<0)
  {
  	n[0]=45;
	num=-num;
  }
  else if(num>=0)
  {
  	n[0]=43;
  }
  n[1]=(num/1000)%10+16+32;
  n[2]=(num/100)%10+16+32;
  n[3]=46;
  n[4]=(num/10)%10+16+32;
  n[5]=num%10+16+32;
  LCD_P8x16Str(x,y,&n[0]);//从ACSII码表中读取字节，然后写入液晶
}

void Draw_Power(uint16 TSC,uint8 qie)
{
  byte is;
  byte n[5]={0};
  if(qie==0)
  {
	if(TSC<=630)
	  TSC=630;
	TSC=TSC-630;
	TSC=TSC/10;
	if(TSC>21)
	   TSC=21;
    for(is=0;is<21;is++)
	{
		dianchi[8+is]=0x04;
		dianchi[40+is]=0x20;
	}	
    for(is=0;is<TSC;is++)
	{
		dianchi[28-is]=0xF4;
		dianchi[60-is]=0x2F;
	}
	Draw_BMP(96,0,127,1,dianchi);  	
  }
  if(qie==1)
  {
	TSC=TSC;
	n[0]=(TSC/100)%10+16+32;
    n[1]=46;
    n[2]=(TSC/10)%10+16+32;
    n[3]=TSC%10+16+32;
//    n[4]='\n';
    LCD_P8x16Str(96,0,&n[0]);//从ACSII码表中读取字节，然后写入液晶
  	//Dis_Num(0,11,TSC,4) ;//3
  }

}

void Draw_XH()
{
	Draw_BMP(0,0,31,1,xinghao);
}

void Draw_WZ(int16 WEI2)
{
    byte iss;
	byte WEI;
	if(WEI2<=-63)
	  WEI2=-63;
	if(WEI2>=63)
	  WEI2=63;		
	WEI=WEI2+63;
    for(iss=0;iss<128;iss++)
	{
	  weizhi[iss]=0x00;
	}	
	weizhi[WEI]=0x7C;
	weizhi[WEI+1]=0x7C;
	Draw_BMP(0,2,127,3,weizhi);
}

void LCD_Write_Char(unsigned char ASCII)
{
    unsigned char n;
	
    ASCII -= 32; //ASCII码-32 得到ASCII字符在点阵中的位置
	
    for (n=0; n<6; n++)
		LCD_WrDat((F6x8[ASCII][n]));
}

void Display_Bar(unsigned char x,unsigned char y,unsigned char num)
{
unsigned char i,j;

	if(num>249)num=249;//限制最大输入为250
i=num/10;  //0-25
LCD_SetXY(x,y);
LCD_WrDat(0x7e);
LCD_WrDat(0x81);
for(j=0;j<i;j++) //开始填充有效的条
{
LCD_WrDat(0xbd);
LCD_WrDat(0xbd);
LCD_WrDat(0xbd);
LCD_WrDat(0x81);
}
if(((num%10)==0)||((num%10)<3))
	{
	LCD_WrDat(0x81);
	LCD_WrDat(0x81);
	LCD_WrDat(0x81);
	LCD_WrDat(0x81);
	}
	else if(((num%10)>=3)&&((num%10)<6))
	{
	LCD_WrDat(0xbd);
	LCD_WrDat(0x81);
	LCD_WrDat(0x81);
	LCD_WrDat(0x81);
	}else if(((num%10)>=6)&&((num%10)<9))
	{
	LCD_WrDat(0xbd);
	LCD_WrDat(0xbd);	
	LCD_WrDat(0x81);
	LCD_WrDat(0x81);
	}
	else{
	LCD_WrDat(0xbd);
	LCD_WrDat(0xbd);	
	LCD_WrDat(0xbd);
	LCD_WrDat(0x81);
	}
	
for(j=0;j<24-i;j++) //填充空白条
{
LCD_WrDat(0x81);
LCD_WrDat(0x81);
LCD_WrDat(0x81);
LCD_WrDat(0x81);
}
LCD_WrDat(0x7e);
//显示输入的数据十进制值
//LCD_P6x8Str(110,y,100);
//LCD_Write_Char(num/100+0x30);
//LCD_Write_Char(num%100/10+0x30);
//LCD_Write_Char(num%10+0x30);

}

void LED_PrintImage(byte *pucTable, word usRowNum, word usColumnNum)
{
    byte ucData;
    word i,j,k,m,n;
    word usRowTmp;

    m = usRowNum >> 3;   //计算图片行数以8位为一组完整的组数
    n = usRowNum % 8;    //计算分完组后剩下的行数

    for(i = 0; i < m; i++) //完整组行扫描
    {
        LCD_Set_Pos(0,i);
        usRowTmp = i << 3;    //计算当前所在行的下标
        for(j = 0; j < usColumnNum; j++) //列扫描
        {
            ucData = 0;
            for(k = 0; k < 8; k++) //在i组中对这8行扫描
            {
                ucData = ucData >> 1;
                if((pucTable + (usRowTmp + k) * usColumnNum)[j] == 0)
                {
                    ucData = ucData | 0x80;
                }

            }
            LCD_WrDat(ucData);
        }
    }

    LCD_Set_Pos(0,(u8)i); //设置剩下的行显示的起始坐标
    usRowTmp = i << 3;       //计算当前所在行的下标
    for(j = 0; j < usColumnNum; j++) //列扫描
    {
        ucData = 0;
        for(k = 0; k < n; k++) //对剩下的行扫描
        {
            ucData = ucData >> 1;
            if((pucTable + (usRowTmp + k) * usColumnNum)[j] == 0)
            {
                ucData = ucData | 0x80;
            }

        }
        ucData = ucData >> (8 - n);
        LCD_WrDat(ucData);
    }

    return;
}



void OLED_clearbuffer(void)
{
	unsigned int j;
	for(j=0;j<1024;j++)
	  OLED_buffer[j]=0;
}

/*void OLED_upbuffer(void)
{
    unsigned int j;
	LCD_SetXY(0,0);
	for(j=0;j<1024;j++)
	  LCD_WrDat(OLED_buffer[j]);
}*/


void LCD_Fill2(byte *bmp_data)
{
	byte y,x;
	
	for(y=0;y<8;y++)
	{
		LCD_WrCmd(0xb0+y);
		LCD_WrCmd(0x01);
		LCD_WrCmd(0x10);
		for(x=0;x<X_WIDTH;x++)
			LCD_WrDat(*bmp_data++);
	}
}

void OLED_upbuffer(void)
{
  LCD_Fill2(OLED_buffer);

}


void SetPixelbuffer(unsigned char x, unsigned char y, unsigned char color)
        {
            if ((x >= COLSIZE-1) || (y >= ROWSIZE*8-1))
                return;
		unsigned char temp;
		temp=OLED_buffer[(y/8)*128+x];
		if (color)temp|=(1<<(y%8));
			else temp&=~(1<<(y%8));
		OLED_buffer[(y/8)*128+x]=temp;
        }


void DrawLine(unsigned char x0, unsigned char y0, unsigned char x1, unsigned char y1, unsigned char color)
        {
            int t;
            char steep = DIF(y1 , y0) > DIF(x1 , x0);
            if (steep)
            {
                t = x0;
                x0 = y0;
                y0 = t;
                t = x1;
                x1 = y1;
                y1 = t;
            }

            if (x0 > x1)
            {
                t = x0;
                x0 = x1;
                x1 = t;

                t = y0;
                y0 = y1;
                y1 = t;
            }

            int dx, dy;
            dx = x1 - x0;
            dy = DIF(y1 , y0);

            int err = (dx / 2);
            int ystep;

            if (y0 < y1)
            {
                ystep = 1;
            }
            else
            {
                ystep = -1;
            }

            for (; x0 < x1; x0++)
            {
                if (steep)
                {
                    SetPixelbuffer(y0, x0, color);
                }
                else
                {
                    SetPixelbuffer(x0, y0, color);
                }
                err -= dy;
                if (err < 0)
                {
                    y0 += (unsigned char)ystep;
                    err += dx;
                }
            }
        }