//============================================================================
// 文件名称：led.c                                                          
// 功能概要：LED构件源文件
// 版权所有: 苏州大学飞思卡尔嵌入式中心(sumcu.suda.edu.cn)
// 版本更新:     时间                     版本                                       修改
//           2012-12-01     V1.0       编写了KL252的LED驱动
//============================================================================
#include "led.h"

//将不连续的引脚用数组表示，使其间接地连贯
uint_8 LED_D[8]= {11,10,9,8,3,2,1,0}; //数据口分别接PTB的{11,10,9,8,3,2,1,0}脚
uint_8 LED_CS[4]= {19,18,17,16};        //位选口分别接PTB的{19,18,17,16}脚


//============================================================================
//函数名称：LEDInit
//函数返回：无
//参数说明：无  
//功能概要：LED初始化。
//============================================================================
void LEDInit()
{ 
	uint_8 i = 0;
	//数据口定义为为输出 ，数据口输出0
    for(i = 0;i < 8;i++)
       gpio_init (LedData, LED_D[i], 1, 0);
    //位选口定义为为输出 ，位选口输出0 
    for(i = 0;i < 4;i++)
        gpio_init (LedCS, LED_CS[i], 1, 0);
   }

//显示码表
const uint_8 Dtable[24] =
//   0    1    2    3    4     5    6    7    8    9	
//   0    1    2    3    4     5    6    7    8    9
  {0x3F,0x06,0x5B,0x4F,0x66, 0x6D,0x7D,0x07,0x7F,0x6F,
//  11    12   13   14   15    16   17   18   19   20
//   0.   1.   2.   3.   4.    5.   6.   7.   8.   9.
   0xBF,0x86,0xDB,0x4F,0x66, 0x6D,0x7D,0x07,0xFF,0x6F,
//   21   22 23(全亮)24（全灭）   
//   E   F   
   0x79,0x71,0xFF,0x00};

//============================================================================
//函数名称：LEDchangeCode
//函数返回：将num对应的Dtable里面的码取出
//参数说明：  num：需要显示的数在Dtable里面的序号
//功能概要：将num转换成对应的Dtable中的码
//============================================================================	
uint_8 LEDchangeCode(uint_8 num)
{
    return Dtable[num];     
}


//============================================================================
//函数名称：LEDshow1
//函数返回：无
//参数说明：i:指定LCD哪一位显示，c:显示的内容 
//功能概要：指定LCD第i位显示c。                                                                    
//============================================================================	
    void LEDshow1(uint_8 i, uint_8 c)
    {
    	uint_8 temp;
		uint_8 j;
    	//位选全部置0  
		for (j=0;j<=3;j++)
		  	gpio_set (LedCS, LED_CS[j], 0);
	    //数据上线       
		for (j=0;j<=7;j++)
		{
    		temp = (c>>j) & 0x01;	
	        gpio_set (LedData, LED_D[j], temp);	
		}
		//选择的位选置1
		gpio_set (LedCS, LED_CS[i], 1);       
	}
